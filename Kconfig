## Kconfig
```kconfig
# General configuration options

# Copyright (c) 2014-2015 Wind River Systems, Inc.
# SPDX-License-Identifier: Apache-2.0

mainmenu "Zephyr Kernel Configuration"

# osource = optional
osource "../app/Kconfig.custom"

source "kconfig.d&h mechatronic AG"

source "Kconfig.zephyr"
```

## drivers/gpio/Kconfig.pca953x
```kconfig
# PCA953X GPIO configuration options

# Copyright (c) 2018 Aapo Vienamo
# Copyright (c) 2021 Laird Connectivity
# SPDX-License-Identifier: Apache-2.0

menuconfig GPIO_PCA953X
	bool "PCA953X I2C GPIO chip"
	default y
	depends on DT_HAS_TI_TCA9538_ENABLED || DH_GPIO_PCA953X_TCA9534
	select I2C
	help
	  Enable driver for supported PCA953X-compatible I2C GPIO chips.

if GPIO_PCA953X

config GPIO_PCA953X_INIT_PRIORITY
	int "Init priority"
	default 70
	help
	  Device driver initialization priority.

endif # GPIO_PCA953X
```

## dts/bindings/gpio/ti,tca9534.yaml
```yaml
# Copyright (c) 2026 D+H Mechatronic AG
# SPDX-License-Identifier: Apache-2.0

description: Texas Instruments TCA9534 8-bit I2C GPIO expander

compatible: "ti,tca9534"

include: [i2c-device.yaml, gpio-controller.yaml]

properties:
  "#gpio-cells":
    const: 2

  ngpios:
    required: true
    const: 8
    description: Number of GPIOs available on the port expander.

  nint-gpios:
    type: phandle-array
    description: Connection for the active-low open-drain INT signal.

gpio-cells:
  - pin
  - flags
```
